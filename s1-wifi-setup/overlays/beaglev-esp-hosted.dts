/dts-v1/;
/plugin/;

/ {
    compatible = "microchip,mpfs-icicle-kit";
    
    fragment@0 {
        target = <&spi0>;
        __overlay__ {
            #address-cells = <1>;
            #size-cells = <0>;
            
            status = "okay";
            
            spidev@0 {
                compatible = "rohm,dh2228fv";
                reg = <0>;
                spi-max-frequency = <10000000>;
            };
        };
    };
};
