## buildroot/configs/beaglev_proplet_defconfig
```kconfig
# ============================================================================
# BeagleV Proplet Configuration - Minimal Edge Worker
# ============================================================================

# Architecture
BR2_riscv=y
BR2_RISCV_64=y
BR2_RISCV_ISA_RVC=y

# System
BR2_SYSTEM_HOSTNAME="proplet-beaglev"
BR2_SYSTEM_BANNER="Propeller Proplet Edge Worker"
BR2_SYSTEM_DHCP="eth0"
BR2_ROOTFS_OVERLAY="$(BR2_EXTERNAL_PROPELLER_PATH)/board/beaglev/rootfs_overlay"
BR2_ROOTFS_POST_BUILD_SCRIPT="$(BR2_EXTERNAL_PROPELLER_PATH)/board/beaglev/post-build.sh"

# Toolchain
BR2_TOOLCHAIN_BUILDROOT_GLIBC=y
BR2_TOOLCHAIN_BUILDROOT_CXX=y
BR2_TOOLCHAIN_BUILDROOT_WCHAR=y
BR2_GCC_VERSION_13_X=y

# Linux Kernel
BR2_LINUX_KERNEL=y
BR2_LINUX_KERNEL_CUSTOM_VERSION=y
BR2_LINUX_KERNEL_CUSTOM_VERSION_VALUE="6.6"
BR2_LINUX_KERNEL_DEFCONFIG="defconfig"
BR2_LINUX_KERNEL_DTS_SUPPORT=y

# Init system
BR2_INIT_SYSTEMD=y
BR2_PACKAGE_SYSTEMD_NETWORKD=y
BR2_PACKAGE_SYSTEMD_RESOLVED=y

# Build tools
BR2_PACKAGE_HOST_GO=y
BR2_PACKAGE_HOST_RUSTC=y
BR2_PACKAGE_HOST_PKGCONF=y

# Core libraries (minimal)
BR2_PACKAGE_OPENSSL=y
BR2_PACKAGE_CA_CERTIFICATES=y

# Propeller packages
BR2_PACKAGE_WASMTIME=y
BR2_PACKAGE_PROPLET=y

# Networking
BR2_PACKAGE_DHCPCD=y
BR2_PACKAGE_OPENSSH=y
BR2_PACKAGE_IPROUTE2=y
BR2_PACKAGE_ETHTOOL=y

# Debugging tools (optional, remove for production)
BR2_PACKAGE_STRACE=y
BR2_PACKAGE_HTOP=y

# Filesystem
BR2_TARGET_ROOTFS_EXT2=y
BR2_TARGET_ROOTFS_EXT2_4=y
BR2_TARGET_ROOTFS_EXT2_SIZE="512M"

# Optimization
BR2_OPTIMIZE_2=y
BR2_ENABLE_DEBUG=y
```

## buildroot/package/proplet/config.in
```kconfig
config BR2_PACKAGE_PROPLET
	bool "proplet"
	depends on BR2_PACKAGE_HOST_RUSTC_TARGET_ARCH_SUPPORTS
	select BR2_PACKAGE_HOST_RUSTC
	select BR2_PACKAGE_WASMTIME
	select BR2_PACKAGE_OPENSSL
	help
	  Proplet is a lightweight worker service that executes
	  WebAssembly workloads on edge devices. Written in Rust.
	  
	  It connects to a SuperMQ/Magistrala broker via MQTT and
	  receives WASM workloads to execute using Wasmtime runtime.

	  https://github.com/absmach/propeller

comment "proplet needs a Rust toolchain"
	depends on !BR2_PACKAGE_HOST_RUSTC_TARGET_ARCH_SUPPORTS
```

## buildroot/package/wasmtime/Config.in
```kconfig
config BR2_PACKAGE_WASMTIME
	bool "wasmtime"
	depends on BR2_PACKAGE_HOST_RUSTC_TARGET_ARCH_SUPPORTS
	select BR2_PACKAGE_HOST_RUSTC
	help
	  Wasmtime is a standalone runtime for WebAssembly, using the
	  Cranelift JIT compiler. It provides a fast, secure, and
	  lightweight execution environment for WebAssembly modules.

	  https://wasmtime.dev/

comment "wasmtime needs a Rust toolchain"
	depends on !BR2_PACKAGE_HOST_RUSTC_TARGET_ARCH_SUPPORTS
```

## config.in
```kconfig
source "$BR2_EXTERNAL_PROPELLER_PROPLET_PATH/package/wasmtime/Config.in"
source "$BR2_EXTERNAL_PROPELLER_PROPLET_PATH/package/proplet/Config.in"
```

## configs/beaglev_proplet_defconfig
```kconfig
# Architecture
BR2_riscv=y
BR2_RISCV_64=y

# System
BR2_SYSTEM_DHCP="eth0"
BR2_ROOTFS_OVERLAY="$(BR2_EXTERNAL_PROPELLER_PATH)/board/beaglev/rootfs_overlay"

# Toolchain
BR2_TOOLCHAIN_BUILDROOT_GLIBC=y
BR2_TOOLCHAIN_BUILDROOT_CXX=y

# Kernel
BR2_LINUX_KERNEL=y
BR2_LINUX_KERNEL_CUSTOM_VERSION=y
BR2_LINUX_KERNEL_CUSTOM_VERSION_VALUE="6.1"
BR2_LINUX_KERNEL_DEFCONFIG="defconfig"
BR2_LINUX_KERNEL_DTS_SUPPORT=y

# Filesystem
BR2_TARGET_ROOTFS_EXT2=y
BR2_TARGET_ROOTFS_EXT2_4=y

# Packages
BR2_PACKAGE_WAMR=y
BR2_PACKAGE_PROPLET=y
BR2_PACKAGE_OPENSSL=y
BR2_PACKAGE_LIBCURL=y

# Init system
BR2_INIT_SYSTEMD=y

# Network
BR2_PACKAGE_DHCPCD=y
BR2_PACKAGE_OPENSSH=y

# Build options
BR2_ENABLE_DEBUG=y
BR2_OPTIMIZE_2=y
```

## package/proplet/config.in
```kconfig
config BR2_PACKAGE_PROPLET
	bool "proplet"
	depends on BR2_PACKAGE_HOST_GO_TARGET_ARCH_SUPPORTS
	depends on BR2_PACKAGE_HOST_GO_TARGET_CGO_LINKING_SUPPORTS
	help
	  Proplet is a lightweight agent for managing and monitoring
	  edge devices as part of the Propeller system.

	  https://github.com/absmach/propeller

comment "proplet needs a toolchain w/ CGO support"
	depends on !BR2_PACKAGE_HOST_GO_TARGET_CGO_LINKING_SUPPORTS
```

## package/wasmtime/config.in
```kconfig
config BR2_PACKAGE_WASMTIME
	bool "wasmtime"
	depends on BR2_PACKAGE_HOST_RUSTC_TARGET_ARCH_SUPPORTS
	depends on BR2_TOOLCHAIN_HAS_THREADS
	depends on BR2_USE_WCHAR
	depends on BR2_INSTALL_LIBSTDCPP
	help
	  Wasmtime is a fast, secure WebAssembly runtime.
	  
	  This package builds both the CLI tool and the C API library
	  for embedding in applications like Proplet.
	  
	  Note: Building Wasmtime from source on RISC-V takes 1-3 hours.

	  https://wasmtime.dev/

comment "wasmtime needs wchar, threads, C++, and Rust support"
	depends on !BR2_USE_WCHAR || !BR2_TOOLCHAIN_HAS_THREADS \
		|| !BR2_INSTALL_LIBSTDCPP \
		|| !BR2_PACKAGE_HOST_RUSTC_TARGET_ARCH_SUPPORTS
		
```
